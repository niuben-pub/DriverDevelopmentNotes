## 01_sample_chardev_hellosky/code/hellosky/Kconfig
```kconfig
# audio info  configuration
#
config SKY_HELLO_SKY
	tristate "Amlogic audio info support"
	default m
	help
		support the amlogic audio info;
```
